## kernels/linux-2.6.16-gazineu/drivers/star/str8100/Kconfig
```kconfig
#
# STAR Equuleus LED support 
#

menu "STAR Equuleus LED support"

config STR8100_WLX652_LEDS
	tristate "Star 8132 - WLX652 - Leds control"
	help
	  Enable Star Leds control for WLX652 board

endmenu
```
